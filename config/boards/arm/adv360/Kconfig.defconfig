## config/boards/arm/adv360/Kconfig.defconfig
```kconfig
#
# Copyright (c) 2021 Polarity Works
# SPDX-License-Identifier: MIT
#

if BOARD_ADV360_LEFT

	config ZMK_KEYBOARD_NAME
	default "Adv360 Pro"

endif # BOARD_ADV360_LEFT

if BOARD_ADV360_RIGHT

	config ZMK_KEYBOARD_NAME
	default "Adv360 Pro rt"

endif # BOARD_ADV360_RIGHT


if BOARD_ADV360_LEFT || BOARD_ADV360_RIGHT

config BOARD
	default "adv360"

config ZMK_SPLIT
	default y

config SPI
    bool
    default y

config BT_CTLR
	default BT

config ZMK_BLE
	default y

config ZMK_USB
	default y

if USB

config USB_NRFX
	default y

config USB_DEVICE_STACK
	default y

config ZMK_SLEEP
	default n
	
config ZMK_IDLE_SLEEP_TIMEOUT
	default 3600000
	
if ZMK_BACKLIGHT

config ZMK_BACKLIGHT_ON_START
	default y

config ZMK_BACKLIGHT_BRT_START
	default 80

config ZMK_BACKLIGHT_AUTO_OFF_IDLE
	default n

endif # ZMK_BACKLIGHT

endif # USB

config ZMK_BATTERY_VOLTAGE_DIVIDER
	default y

config SPI
	default y



endif # BOARD_ADV360_LEFT || BOARD_ADV360_RIGHT
```
